## app/boards/shields/slicemk_ergodox/Kconfig.defconfig
```kconfig
if SHIELD_SLICEMK_ERGODOX_LEFTCENTRAL || SHIELD_SLICEMK_ERGODOX_RIGHT

config ZMK_KEYBOARD_NAME
    default "SliceMK ErgoDox"

config ZMK_BLE
    default y

config ZMK_SPLIT
    default y

endif

if SHIELD_SLICEMK_ERGODOX_LEFTCENTRAL

config ZMK_USB
    default y

config ZMK_SPLIT_ROLE_CENTRAL
    default y

endif
```

## app/boards/shields/slicemk_ergodox/Kconfig.shield
```kconfig
config SHIELD_SLICEMK_ERGODOX_LEFTCENTRAL
    def_bool $(shields_list_contains,slicemk_ergodox_leftcentral)

config SHIELD_SLICEMK_ERGODOX_RIGHT
    def_bool $(shields_list_contains,slicemk_ergodox_right)
```

## app/boards/slicemk/slicemk_ergodox/Kconfig.slicemk_ergodox
```kconfig
# SPDX-License-Identifier: MIT

config BOARD_SLICEMK_ERGODOX_202205_GREEN_LEFT
    select SOC_NRF52833_QIAA
    select ZMK_BOARD_COMPAT

config BOARD_SLICEMK_ERGODOX_202205_GREEN_RIGHT
    select SOC_NRF52833_QIAA
    select ZMK_BOARD_COMPAT

config BOARD_SLICEMK_ERGODOX_202207_GREEN_LEFT
    select SOC_NRF52833_QIAA
    select ZMK_BOARD_COMPAT

config BOARD_SLICEMK_ERGODOX_202207_GREEN_RIGHT
    select SOC_NRF52833_QIAA
    select ZMK_BOARD_COMPAT
```

## app/boards/slicemk/slicemk_ergodox/Kconfig.slicemk_ergodox_202205_green_right
```kconfig
# SPDX-License-Identifier: MIT

config BOARD_SLICEMK_ERGODOX_202205_GREEN_RIGHT
    select SOC_NRF52833_QIAA
    select ZMK_BOARD_COMPAT
```

## app/boards/slicemk/slicemk_ergodox/Kconfig.slicemk_ergodox_202207_green_left
```kconfig
# SPDX-License-Identifier: MIT

config BOARD_SLICEMK_ERGODOX_202207_GREEN_LEFT
    select SOC_NRF52833_QIAA
    select ZMK_BOARD_COMPAT
```

## app/boards/slicemk/slicemk_ergodox/board.yml
```yaml
boards:
  - name: slicemk_ergodox_202205_green_left
    vendor: slicemk
    socs:
      - name: nrf52833
  - name: slicemk_ergodox_202205_green_right
    vendor: slicemk
    socs:
      - name: nrf52833
  - name: slicemk_ergodox_202207_green_left
    vendor: slicemk
    socs:
      - name: nrf52833
  - name: slicemk_ergodox_202207_green_right
    vendor: slicemk
    socs:
      - name: nrf52833
```
